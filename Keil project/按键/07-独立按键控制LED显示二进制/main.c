/*
 * 07-独立按键控制LED显示二进制 - 普中A2开发板
 * 功能：K1按键每按一次，LED显示的二进制数加1（0→1→2→3…）
 * 作者：freedom
 * 日期：2026-07-15
 *
 * 硬件连接：
 *   LED（D1-D8） → P2.0-P2.7（低电平点亮）
 *   独立按键K1 → P3.1（按下为低电平）
 */

#include <REGX52.H>
void Delay(unsigned int xms)  //11.0592MHz晶振下的延时函数
{
    unsigned char i, j;
    while (xms--)
    {
        i = 6;
        j = 200;
        do
        {
            while (--j);
        } while (--i);
    }
}

void main(void)
{
    unsigned char K1NUM = 0; // K1按键按下次数计数器

    while (1)
    {
        P2 = ~K1NUM;        // 将按键按下次数的二进制值输出到 P2 口
        if (P3_1 == 0)  // 检测 K1 是否按下
        {
             Delay(20);   // 延时 20ms 消抖
             if (P3_1 == 0) // 再次检测 K1 是否按下
             {
                while ((P3_1) == 0); // 等待按键松开
                Delay(20);         // 再次延时 20ms 消抖 
                K1NUM++;               // K1按键按下次数加1       
            }
        }
    }
}
/*
写代码中遇到的问题
1.读取单个引脚标准写法是P3_1或sbit P3_1 = P3^1;，而不是P3^1.
所以在main函数中检测按键是否按下的条件应该是if(P3_1==0)而不是if(P3^1==0)
2.应先定义独立软件变量K1NUM来记录按键按下次数，每次按键松开执行K1NUM++，只修改内存中的变量K1NUM的值，而不是直接修改P2口的值。
*/

/*
不直接修改P2口的值的原因：
1. P2是硬件寄存器，不止控制LED灯。单片机运行中P2会受硬件，其他代码改写，存不住稳定的按键次数。
2. 通过修改K1NUM变量的值，可以更好地控制LED灯的状态，同时也可以方便地进行调试和维护。
3. 直接修改P2口的值可能会导致程序的可读性和可维护性降低，而使用K1NUM变量可以使代码更清晰易懂。  
 */