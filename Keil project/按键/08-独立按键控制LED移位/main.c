/*  
08-独立按键控制LED移位 - 普中A2开发板
功能：K1按键每按一次，LED显示的二进制数左移一位（11111110→11111101→11111011…）
作者：freedom
日期：2026-07-15
硬件连接：
  LED（D1-D8） → P2.0-P2.7（低电平点亮）
  独立按键K1 → P3.1（按下为低电平）
*/
#include <REGX52.H>
// 定义按键 K1（P3.1 位寻址）
sbit K1 = P3^1;
void Delay(unsigned int xms)  //11.0592MHz晶振下的延时函数
{
    unsigned char i, j;
    while (xms--)
    {
        i = 6;
        j = 200;
        do
        {
            while (--j);
        } while (--i);
    }
}

void main(void)
{
    P2 = 0xFE; // 初始状态，点亮P2.0的LED，11111110
    while(1)
    {
        if(K1==0)  // 按键按下
        {
            Delay(15);  // 消抖
            if(K1==0)
            {
                while(K1==0);  // 等待按键释放
                Delay(15);  // 消抖
                 P2=(P2<<1)|0x01;  // 左移一位，最低位补1
                //P2=(P2>>1)|0x80;  // 右移一位，最高位补1
               if(P2==0XFF)  // 如果LED全部熄灭
                {
                    P2=0xFE;  // 恢复初始状态
                }
            }
        }
    }
}
/*  
注意事项：
1. 读取单个引脚标准写法是P3_1或sbit P3_1 = P3^1;，而不是P3^1.
2.机械按键在按下和释放的过程中会产生抖动现象，一般为5ms到10ms，可能会导致程序误判按键状态，因此需要进行消抖处理。
3.按下时和释放时都需要进行消抖处理，防止误判。s
*/