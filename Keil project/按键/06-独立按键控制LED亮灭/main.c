/*
 * 06-独立按键控制LED亮灭 - 普中A2开发板
 * 功能：K1按键每按一次，LED状态翻转（亮→灭→亮→灭…）
 * 作者：freedom
 * 日期：2026-07-15
 *
 * 硬件连接：
 *   LED（D1） → P2.0（低电平点亮）
 *   独立按键K1 → P3.1（按下为低电平）
 */

#include <REGX52.H>
#include <intrins.h>

// ===== 引脚定义 =====
sbit KEY1 = P3^1;   // K1：独立按键（按下低电平）
sbit LED1 = P2^0;   // D1：LED灯（低电平点亮）

// 按键消抖延迟
void Delay20ms(void) //@11.0592MHz
{
    unsigned char i, j;
    for (i = 0; i < 20; i++)
    {
        for (j = 0; j < 200; j++);
    }
}
//一般机械抖动为5到10ms，20ms足够消抖（小于由它机械特性决定的抖动时间，按键会误读）
void main(void)
{
    LED1 = 1; // 初始状态：LED1熄灭（高电平）

    while (1)
    {
        if (KEY1 == 0)   // 检测K1按下
        {
            Delay20ms(); // 消抖
            if (KEY1 == 0)
            {
                LED1 = !LED1;      // 翻转LED状态
                while (KEY1 == 0); // 等待按键松开
                Delay20ms();       // 再次消抖
            }
        }
    }
}
/* 说明：
 * 1. 按键K1按下时，LED1状态翻转（亮→灭→亮→灭…）。
 * 2. 使用消抖延迟函数Delay20ms()来避免按键抖动导致的误触发。
 * 3. LED1初始状态为熄灭（高电平），按下K1后会点亮（低电平）。
 */

/*  写代码过程中的错误总结
 *  错误1：按键消抖处理的延迟函数时间不够，导致按键抖动引起误触发。
 *  错误2：未写按键松开等待的逻辑，代码检测到一次 KEY1==0 之后就直接翻转如果还没等到手松开，下一次循环可能又读到一次按下或抖动，结果表现不稳定。
 *  错误3：LED初始状态设置错误，导致第一次按下按键时LED状态不符合预期。（IO口都有上拉电阻，所以初始状态应该为高电平）
 */